## waitaha-br2-external/Config.in
```kconfig
# Add waitaha-specific packages here
source "$BR2_EXTERNAL_WAITAHA_PATH/package/deviceinfo/Config.in"
source "$BR2_EXTERNAL_WAITAHA_PATH/package/drm-info/Config.in"
source "$BR2_EXTERNAL_WAITAHA_PATH/package/qrtr/Config.in"
source "$BR2_EXTERNAL_WAITAHA_PATH/package/rmtfs/Config.in"
source "$BR2_EXTERNAL_WAITAHA_PATH/package/tqftpserv/Config.in"
source "$BR2_EXTERNAL_WAITAHA_PATH/package/waitaha-ui/Config.in"

# Device firmware packages
source "$BR2_EXTERNAL_WAITAHA_PATH/package/firmware-davinci/Config.in"
source "$BR2_EXTERNAL_WAITAHA_PATH/package/firmware-sweet/Config.in"
```

## waitaha-br2-external/configs/davinci_defconfig
```kconfig
BR2_LINUX_KERNEL_INTREE_DTS_NAME="qcom/sm7150-xiaomi-davinci"
BR2_PACKAGE_FIRMWARE_DAVINCI=y
BR2_PACKAGE_DEVICEINFO_INFO="corner_radius=15,notch_location=none,name=Xiaomi Mi 9T,codename=davinci,manufacturer=xiaomi"
```

## waitaha-br2-external/configs/sm7150_defconfig
```kconfig
BR2_aarch64=y
BR2_cortex_a76_a55=y
BR2_ROOTFS_POST_IMAGE_SCRIPT_ARGS="--cmdline console=tty0 --base 0x00000000 --kernel_offset 0x00008000 --ramdisk_offset 0x01000000 --second_offset 0x00000000 --tags_offset 0x00000100 --pagesize 4096"
BR2_LINUX_KERNEL_CUSTOM_GIT=y
BR2_LINUX_KERNEL_CUSTOM_REPO_URL="https://github.com/sm7150-mainline/linux"
BR2_LINUX_KERNEL_CUSTOM_REPO_VERSION="7e07271cadf3704378b6b0ae32fc9227c5cd58d3"
BR2_LINUX_KERNEL_USE_ARCH_DEFAULT_CONFIG=y
BR2_LINUX_KERNEL_CONFIG_FRAGMENT_FILES="$(LINUX_DIR)/arch/arm64/configs/sm7150.config"
BR2_PACKAGE_MESA3D_GALLIUM_DRIVER_FREEDRENO=y
BR2_PACKAGE_LINUX_FIRMWARE=y
BR2_PACKAGE_LINUX_FIRMWARE_QCOM_ADRENO=y
BR2_PACKAGE_LINUX_FIRMWARE_QUALCOMM_3990_BT=y
BR2_PACKAGE_LINUX_FIRMWARE_ATHEROS_10K_WCN3990=y
BR2_PACKAGE_RMTFS=y
BR2_PACKAGE_TQFTPSERV=y
```

## waitaha-br2-external/configs/sweet_defconfig
```kconfig
BR2_LINUX_KERNEL_INTREE_DTS_NAME="qcom/sm7150-xiaomi-sweet"
BR2_PACKAGE_FIRMWARE_SWEET=y
BR2_PACKAGE_DEVICEINFO_INFO="corner_radius=15,notch_location=center,notch_width=5,notch_height=5,name=Redmi Note 10 Pro,codename=sweet,manufacturer=xiaomi"
```

## waitaha-br2-external/configs/waitaha_defconfig
```kconfig
BR2_TOOLCHAIN_EXTERNAL=y
BR2_CCACHE=y
BR2_ENABLE_LTO=y
BR2_PER_PACKAGE_DIRECTORIES=y
BR2_TARGET_GENERIC_HOSTNAME="waitaha"
BR2_TARGET_GENERIC_ISSUE="Welcome to my waitaha"
BR2_ROOTFS_DEVICE_CREATION_DYNAMIC_EUDEV=y
BR2_ROOTFS_MERGED_USR=y
BR2_TARGET_GENERIC_ROOT_PASSWD=""
BR2_ROOTFS_OVERLAY="$(BR2_EXTERNAL_WAITAHA_PATH)/rootfs-overlay"
BR2_LINUX_KERNEL=y
BR2_LINUX_KERNEL_IMAGEGZ=y
BR2_LINUX_KERNEL_DTS_SUPPORT=y
BR2_LINUX_KERNEL_INSTALL_TARGET=y
BR2_LINUX_KERNEL_NEEDS_HOST_OPENSSL=y
BR2_ROOTFS_POST_BUILD_SCRIPT="$(BR2_EXTERNAL_WAITAHA_PATH)/board/waitaha/post-build.sh"
BR2_ROOTFS_POST_IMAGE_SCRIPT="$(BR2_EXTERNAL_WAITAHA_PATH)/board/waitaha/post-image.sh"
BR2_PACKAGE_BUSYBOX_CONFIG_FRAGMENT_FILES="$(BR2_EXTERNAL_WAITAHA_PATH)/configs/busybox_defconfig"
BR2_PACKAGE_MESA3D=y
BR2_PACKAGE_MESA3D_OPENGL_EGL=y
BR2_PACKAGE_MESA3D_OPENGL_ES=y
BR2_PACKAGE_FONTCONFIG=y
BR2_PACKAGE_LIBSELINUX=y
BR2_PACKAGE_READLINE=y
BR2_PACKAGE_GOOGLEFONTDIRECTORY=y
BR2_PACKAGE_GOOGLEFONTDIRECTORY_FONTS="ofl/notosans"
BR2_PACKAGE_DROPBEAR=y
# BR2_PACKAGE_DROPBEAR_CLIENT is not set
BR2_PACKAGE_IWD=y
BR2_TARGET_ROOTFS_CPIO=y
BR2_TARGET_ROOTFS_CPIO_GZIP=y
# BR2_TARGET_ROOTFS_TAR is not set
BR2_PACKAGE_WAITAHA_UI=y
```

## waitaha-br2-external/package/deviceinfo/Config.in
```kconfig
config BR2_PACKAGE_DEVICEINFO
	bool "Deviceinfo file"
	help
	  This package creates the /etc/deviceinfo file.

if BR2_PACKAGE_DEVICEINFO

config BR2_PACKAGE_DEVICEINFO_INFO
	string "Deviceinfo flags"

endif
```

## waitaha-br2-external/package/drm-info/Config.in
```kconfig
config BR2_PACKAGE_DRM_INFO
	bool "Small utility to dump info about DRM devices"
	select BR2_PACKAGE_LIBDRM
	select BR2_PACKAGE_JSON_C
	help
	  This package builds the drm_info utility to dump info about DRM devices.
```

## waitaha-br2-external/package/firmware-davinci/Config.in
```kconfig
config BR2_PACKAGE_FIRMWARE_DAVINCI
	bool "Firmware files for davinci"
	help
	  This package contains firmware files for davinci.
```

## waitaha-br2-external/package/firmware-sweet/Config.in
```kconfig
config BR2_PACKAGE_FIRMWARE_SWEET
	bool "Firmware files for sweet"
	help
	  This package contains firmware files for sweet.
```

## waitaha-br2-external/package/modules-autoload/Config.in
```kconfig
config BR2_PACKAGE_MODULES_AUTOLOAD
	bool "Shell script to automatically load kernel modules"
	help
	  This package adds an init script that loads modules configured
	  at build time.

if BR2_PACKAGE_MODULES_AUTOLOAD

config BR2_PACKAGE_MODULES_AUTOLOAD_MODULES
	string "Space-separated list of modules to load"
	help
	  This is a space-separated list of kernel modules to load at boot

endif
```

## waitaha-br2-external/package/modules-davinci/Config.in
```kconfig
config BR2_PACKAGE_MODULES_DAVINCI
	bool "modules-load.d entry for davinci"
	help
	  This package creates a modules-load.d for davinci.
```

## waitaha-br2-external/package/qrtr/Config.in
```kconfig
config BR2_PACKAGE_QRTR
	bool "Userspace reference for net/qrtr in the Linux kernel"
	help
	  This package builds the qrtr library.
```

## waitaha-br2-external/package/rmtfs/Config.in
```kconfig
config BR2_PACKAGE_RMTFS
	bool "Qualcomm Remote Filesystem Service Implementation"
    depends on BR2_PACKAGE_HAS_UDEV # libudev
    select BR2_PACKAGE_QRTR
	help
	  This package builds the rmtfs executable.
```

## waitaha-br2-external/package/tqftpserv/Config.in
```kconfig
config BR2_PACKAGE_TQFTPSERV
	bool "Trivial File Transfer Protocol server over AF_QIPCRTR"
    select BR2_PACKAGE_QRTR
    select BR2_PACKAGE_ZSTD
	help
	  This package builds the tqftpserv binary.
```

## waitaha-br2-external/package/waitaha-ui/Config.in
```kconfig
config BR2_PACKAGE_WAITAHA_UI
	bool "waitaha recovery UI"
	depends on BR2_PACKAGE_HOST_RUSTC_TARGET_ARCH_SUPPORTS
	depends on BR2_PACKAGE_HAS_UDEV # libudev
	depends on BR2_PACKAGE_HAS_LIBGBM
	select BR2_PACKAGE_HOST_RUSTC
	select BR2_PACKAGE_LIBINPUT
	select BR2_PACKAGE_LIBXKBCOMMON
	help
	  This package is the main recovery UI for waitaha.
```
